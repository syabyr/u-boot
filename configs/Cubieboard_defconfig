## configs/Cubieboard_defconfig
```kconfig
CONFIG_ARM=y
CONFIG_ARCH_SUNXI=y
CONFIG_DEFAULT_DEVICE_TREE="sun4i-a10-cubieboard"
CONFIG_SPL=y
CONFIG_MACH_SUN4I=y
CONFIG_DRAM_CLK=480
CONFIG_MMC0_CD_PIN="PH1"
CONFIG_SATAPWR="PB8"
CONFIG_AHCI=y
# CONFIG_SYS_MALLOC_CLEAR_ON_INIT is not set
CONFIG_SPL_I2C=y
CONFIG_SCSI_AHCI=y
CONFIG_SYS_I2C_MVTWSI=y
CONFIG_SYS_I2C_SLAVE=0x7f
CONFIG_SYS_I2C_SPEED=400000
CONFIG_MII=y
CONFIG_SUN4I_EMAC=y
CONFIG_SCSI=y
CONFIG_USB_EHCI_HCD=y
CONFIG_USB_OHCI_HCD=y

CONFIG_MTD=y
CONFIG_CMD_MTDPARTS=y
CONFIG_MTD_RAW_NAND=y
CONFIG_SYS_NAND_BLOCK_SIZE=0x200000
CONFIG_SYS_NAND_PAGE_SIZE=0x2000
CONFIG_SYS_NAND_OOBSIZE=0x280
CONFIG_NAND_SUNXI=y
CONFIG_MTD_UBI=y
CONFIG_CMD_MTD=y
CONFIG_MTDPARTS_DEFAULT="mtdparts=nand0:2m(nand.spl),2m(nand.spl_bak),2m(nand.uboot_env),2m(nand.uboot_bak),2m(nand.uboot),2m(nand.dtb),6m(nand.kernel),-(nand.rootfs)"
CONFIG_ENV_IS_IN_NAND=y
CONFIG_ENV_SIZE=0x200000
CONFIG_ENV_OFFSET=0x400000
CONFIG_CMD_UBI=y
CONFIG_CMD_UBIFS=y
```

## configs/LicheePi_Zero_mybays_defconfig
```kconfig
CONFIG_ARM=y
CONFIG_ARCH_SUNXI=y
CONFIG_DEFAULT_DEVICE_TREE="sun8i-v3s-licheepi-zero"
CONFIG_SPL=y
CONFIG_MACH_SUN8I_V3S=y
CONFIG_DRAM_CLK=360
CONFIG_CMD_MDIO=y
CONFIG_PHYLIB=y
CONFIG_PHY_ADDR_ENABLE=y
CONFIG_PHY_ADDR=1
CONFIG_NETDEVICES=y
CONFIG_PHY_GIGE=y
CONFIG_SUN8I_EMAC=y
```
